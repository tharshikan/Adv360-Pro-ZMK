  macro_quotes: macro_quotes {
    compatible = "zmk,behavior-macro";
    label = "macro_quotes";
    #binding-cells = <0>;
    bindings = <&kp SQT>, <&kp SQT>, <&kp LEFT>;
  };
  macro_dquotes: macro_dquotes {
    compatible = "zmk,behavior-macro";
    label = "macro_dquotes";
    #binding-cells = <0>;
    bindings = <&kp DQT>, <&kp DQT>, <&kp LEFT>;
  };
  macro_braces: macro_braces {
    compatible = "zmk,behavior-macro";
    label = "macro_braces";
    #binding-cells = <0>;
    bindings = <&kp LBRC>, <&kp RBRC>, <&kp LEFT>;
  };
  macro_parens: macro_parens {
    compatible = "zmk,behavior-macro";
    label = "macro_parens";
    #binding-cells = <0>;
    bindings = <&kp LPAR>, <&kp RPAR>, <&kp LEFT>;
  };
  macro_brackets: macro_brackets {
    compatible = "zmk,behavior-macro";
    label = "macro_brackets";
    #binding-cells = <0>;
    bindings = <&kp LBKT>, <&kp RBKT>, <&kp LEFT>;
  };
  macro_kinesis: macro_kinesis {
    compatible = "zmk,behavior-macro";
    label = "macro_kinesis";
    #binding-cells = <0>;
    bindings = <&kp LS(K)>, <&kp I>, <&kp N>, <&kp E>, <&kp S>, <&kp I>, <&kp S>;
  };
  Win_Cut: Windows_Cut {
    compatible = "zmk,behavior-macro";
    #binding-cells = <0>;
    bindings = <&kp LC(X)>;
    display-name = "Windows Cut";
  };

  Win_Copy: Windows_Copy {
    compatible = "zmk,behavior-macro";
    #binding-cells = <0>;
    bindings = <&kp LC(C)>;
    display-name = "Windows Copy";
  };

  Win_Paste: Windows_Paste {
    compatible = "zmk,behavior-macro";
    #binding-cells = <0>;
    bindings = <&kp LC(V)>;
    display-name = "Windows Paste";
  };

  Win_Select_All: Windows_SelectAll {
      compatible = "zmk,behavior-macro";
      #binding-cells = <0>;
      bindings = <&kp LC(A)>;
      display-name = "Windows Select All";
  };

  Win_Undo: Windows_Undo {
    compatible = "zmk,behavior-macro";
    #binding-cells = <0>;
    bindings = <&kp LC(Z)>;
    display-name = "Windows Undo";
  };

  Win_Desktop: Win_Desk {
    compatible = "zmk,behavior-macro";
    #binding-cells = <0>;
    bindings = <&kp LG(D)>;
    display-name = "Windows Desktop";
  };

  Win_File_Explorer: Win_Explr {
    compatible = "zmk,behavior-macro";
    #binding-cells = <0>;
    bindings = <&kp LG(E)>;
    display-name = "Windows Explorer";
  };

  Win_Snip_Tool: Win_Snip {
    compatible = "zmk,behavior-macro";
    #binding-cells = <0>;
    bindings = <&kp LS(LG(S))>;
    display-name = "Windows Screen Snip";
  };

  Win_Show_All_Windows: Win_ShowAW {
    compatible = "zmk,behavior-macro";
    #binding-cells = <0>;
    bindings = <&kp LG(TAB)>;
    display-name = "Windows Show All Windows";
  };

  Mac_Cut: Mac_Cut {
    compatible = "zmk,behavior-macro";
    #binding-cells = <0>;
    bindings = <&kp LG(X)>;
    display-name = "Mac Cut";
  };

  Mac_Copy: Mac_Copy {
    compatible = "zmk,behavior-macro";
    #binding-cells = <0>;
    bindings = <&kp LG(C)>;
    display-name = "Mac Copy";
  };

  Mac_Paste: Mac_Paste {
    compatible = "zmk,behavior-macro";
    #binding-cells = <0>;
    bindings = <&kp LG(V)>;
    display-name = "Mac Paste";
  };

  Mac_Undo: Mac_Undo {
    compatible = "zmk,behavior-macro";
    #binding-cells = <0>;
    bindings = <&kp LG(Z)>;
    display-name = "Mac Undo";
  };

  Mac_Select_All: Mac_SelAll {
    compatible = "zmk,behavior-macro";
    #binding-cells = <0>;
    bindings = <&kp LG(A)>;
    display-name = "Mac Select All";
  };

  Mac_Mission_Control: Mac_ShowAW {
    compatible = "zmk,behavior-macro";
    #binding-cells = <0>;
    bindings = <&kp LC(UP_ARROW)>;
    display-name = "Mac Show All Windows";
  };

  Mac_Snip_Tool: Mac_Snip {
    compatible = "zmk,behavior-macro";
    #binding-cells = <0>;
    bindings = <&kp LC(LG(LS(NUMBER_4)))>;
    display-name = "Mac Screen Snip";
  };

  Win_Close_Program: Win_Close_Program {
    compatible = "zmk,behavior-macro";
    #binding-cells = <0>;
    bindings = <&kp LA(F4)>;
    display-name = "Windows Close";
  };

  Win_Settings_Menu: Win_Settings_Menu {
    compatible = "zmk,behavior-macro";
    #binding-cells = <0>;
    bindings = <&kp LG(I)>;
    display-name = "Windows Settings";
  };

  Win_Lock_PC: Win_Lock_PC {
    compatible = "zmk,behavior-macro";
    #binding-cells = <0>;
    bindings = <&kp LG(L)>;
    display-name = "Windows Lock";
  };

  Win_Tile_Left: Win_Tile_Left {
    compatible = "zmk,behavior-macro";
    #binding-cells = <0>;
    bindings = <&kp LG(LEFT)>;
    display-name = "Windows Tile Left";
  };

  Win_Tile_Up: Win_Tile_Up {
    compatible = "zmk,behavior-macro";
    #binding-cells = <0>;
    bindings = <&kp LG(UP_ARROW)>;
    display-name = "Windows Tile Up";
  };

  Win_Tile_Down: Win_Tile_Down {
    compatible = "zmk,behavior-macro";
    #binding-cells = <0>;
    bindings = <&kp LG(DOWN)>;
    display-name = "Windows Tile Down";
  };

  Win_Tile_Right: Win_Tile_Right {
    compatible = "zmk,behavior-macro";
    #binding-cells = <0>;
    bindings = <&kp LG(RIGHT)>;
    display-name = "Windows Tile Right";
  };

  Mac_Spotlight_Search: Mac_Spotlight_Search {
    compatible = "zmk,behavior-macro";
    #binding-cells = <0>;
    bindings = <&kp LG(SPACE)>;
    display-name = "Mac Spotlight Search";
  };

  Mac_Close_Program: Mac_Close_Program {
    compatible = "zmk,behavior-macro";
    #binding-cells = <0>;
    bindings = <&kp LG(Q)>;
    display-name = "Mac Close Program";
  };

  Mac_Strike_Through_Text: Mac_Strike_Through_Text {
    compatible = "zmk,behavior-macro";
    #binding-cells = <0>;
    bindings = <&kp LG(LS(X))>;
    display-name = "Mac Strikethrough Text";
  };

  Double_Click: Double_Click {
    compatible = "zmk,behavior-macro";
    #binding-cells = <0>;
    bindings = <&mkp MB1 &mkp MB1>;
    display-name = "Double Click";
  };

  // Find Operations
  Mac_Find: Mac_Find {
    compatible = "zmk,behavior-macro";
    #binding-cells = <0>;
    bindings = <&kp LG(F)>;
    display-name = "Mac Find";
  };

  Mac_Find_Next: Mac_Find_Next {
    compatible = "zmk,behavior-macro";
    #binding-cells = <0>;
    bindings = <&kp LG(G)>;
    display-name = "Mac Find Next";
  };

  Mac_Find_Prev: Mac_Find_Prev {
    compatible = "zmk,behavior-macro";
    #binding-cells = <0>;
    bindings = <&kp LG(LS(G))>;
    display-name = "Mac Find Previous";
  };

  // Redo
  Mac_Redo: Mac_Redo {
    compatible = "zmk,behavior-macro";
    #binding-cells = <0>;
    bindings = <&kp LG(LS(Z))>;
    display-name = "Mac Redo";
  };

  // Select Word (bidirectional)
  Mac_Select_Word_Right: Mac_Select_Word_Right {
    compatible = "zmk,behavior-macro";
    #binding-cells = <0>;
    wait-ms = <10>;
    tap-ms = <10>;
    bindings = <&kp LA(RIGHT)>, <&kp LA(LEFT)>, <&kp LA(LS(RIGHT))>;
    display-name = "Mac Select Word Right";
  };

  Mac_Select_Word_Left: Mac_Select_Word_Left {
    compatible = "zmk,behavior-macro";
    #binding-cells = <0>;
    wait-ms = <10>;
    tap-ms = <10>;
    bindings = <&kp LA(LEFT)>, <&kp LA(RIGHT)>, <&kp LA(LS(LEFT))>;
    display-name = "Mac Select Word Left";
  };

  // Select Line (bidirectional)
  Mac_Select_Line_Right: Mac_Select_Line_Right {
    compatible = "zmk,behavior-macro";
    #binding-cells = <0>;
    wait-ms = <10>;
    tap-ms = <10>;
    bindings = <&kp LG(LEFT)>, <&kp LG(LS(RIGHT))>;
    display-name = "Mac Select Line Right";
  };

  Mac_Select_Line_Left: Mac_Select_Line_Left {
    compatible = "zmk,behavior-macro";
    #binding-cells = <0>;
    wait-ms = <10>;
    tap-ms = <10>;
    bindings = <&kp LG(RIGHT)>, <&kp LG(LS(LEFT))>;
    display-name = "Mac Select Line Left";
  };

  // Extend Word (extend existing selection)
  Mac_Extend_Word_Right: Mac_Extend_Word_Right {
    compatible = "zmk,behavior-macro";
    #binding-cells = <0>;
    wait-ms = <10>;
    tap-ms = <10>;
    bindings = <&kp LA(LS(RIGHT))>;
    display-name = "Mac Extend Word Right";
  };

  Mac_Extend_Word_Left: Mac_Extend_Word_Left {
    compatible = "zmk,behavior-macro";
    #binding-cells = <0>;
    wait-ms = <10>;
    tap-ms = <10>;
    bindings = <&kp LA(LS(LEFT))>;
    display-name = "Mac Extend Word Left";
  };

  // Extend Line
  Mac_Extend_Line_Down: Mac_Extend_Line_Down {
    compatible = "zmk,behavior-macro";
    #binding-cells = <0>;
    wait-ms = <10>;
    tap-ms = <10>;
    bindings = <&kp LS(DOWN)>, <&kp LG(LS(RIGHT))>;
    display-name = "Mac Extend Line Down";
  };

  Mac_Extend_Line_Up: Mac_Extend_Line_Up {
    compatible = "zmk,behavior-macro";
    #binding-cells = <0>;
    wait-ms = <10>;
    tap-ms = <10>;
    bindings = <&kp LS(UP)>, <&kp LG(LS(LEFT))>;
    display-name = "Mac Extend Line Up";
  };

  Mac_Search_Bar: Mac_Search_Bar {
    compatible = "zmk,behavior-macro";
    #binding-cells = <0>;
    bindings = <&kp LG(SPACE)>;
    display-name = "Mac Spotlight Search";
  };

  Mac_URL_Bar: Mac_URL_Bar {
    compatible = "zmk,behavior-macro";
    #binding-cells = <0>;
    bindings = <&kp LG(L)>;
    display-name = "Mac URL Bar";
  };

  Mac_Downloads: Mac_Downloads {
    compatible = "zmk,behavior-macro";
    #binding-cells = <0>;
    bindings = <&kp LG(LA(L))>;
    display-name = "Mac Downloads";
  };

  Mac_Find_Replace: Mac_Find_Replace {
    compatible = "zmk,behavior-macro";
    #binding-cells = <0>;
    bindings = <&kp LG(LA(F))>;
    display-name = "Mac Find Replace";
  };

  Mac_Emoji: Mac_Emoji {
    compatible = "zmk,behavior-macro";
    #binding-cells = <0>;
    bindings = <&kp LC(LG(SPACE))>;
    display-name = "Mac Emoji Picker";
  };

  Mac_Select_Next: Mac_Select_Next {
    compatible = "zmk,behavior-macro";
    #binding-cells = <0>;
    bindings = <&kp LG(D)>;
    display-name = "Mac Select Next";
  };

  Mac_Prev_Tab: Mac_Prev_Tab {
    compatible = "zmk,behavior-macro";
    #binding-cells = <0>;
    bindings = <&kp LC(LS(TAB))>;
    display-name = "Mac Previous Tab";
  };

  Mac_Del_Word: Mac_Del_Word {
    compatible = "zmk,behavior-macro";
    #binding-cells = <0>;
    bindings = <&kp LA(BSPC)>;
    display-name = "Mac Delete Word";
  };

  Mac_Sel_Para: Mac_Sel_Para {
    compatible = "zmk,behavior-macro";
    #binding-cells = <0>;
    bindings = <&kp LA(LS(DOWN))>;
    display-name = "Mac Select Paragraph";
  };

  Mac_Comment: Mac_Comment {
    compatible = "zmk,behavior-macro";
    #binding-cells = <0>;
    bindings = <&kp LG(FSLH)>;
    display-name = "Mac Comment Code";
  };

  macro_fat_arrow: macro_fat_arrow {
    compatible = "zmk,behavior-macro";
    #binding-cells = <0>;
    wait-ms = <30>;
    tap-ms = <30>;
    bindings = <&macro_release &kp LSHFT &kp RSHFT>, <&kp EQUAL &kp GT>;
    display-name = "Fat Arrow";
  };

  macro_add_assign: macro_add_assign {
    compatible = "zmk,behavior-macro";
    #binding-cells = <0>;
    wait-ms = <30>;
    tap-ms = <30>;
    bindings = <&macro_release &kp LSHFT &kp RSHFT>, <&kp PLUS &kp EQUAL>;
    display-name = "Add Assign";
  };

  macro_not_equal: macro_not_equal {
    compatible = "zmk,behavior-macro";
    #binding-cells = <0>;
    wait-ms = <30>;
    tap-ms = <30>;
    bindings = <&macro_release &kp LSHFT &kp RSHFT>, <&kp EXCL &kp EQUAL>;
    display-name = "Not Equal";
  };

  macro_thin_arrow: macro_thin_arrow {
    compatible = "zmk,behavior-macro";
    #binding-cells = <0>;
    wait-ms = <30>;
    tap-ms = <30>;
    bindings = <&macro_release &kp LSHFT &kp RSHFT>, <&kp MINUS &kp GT>;
    display-name = "Thin Arrow";
  };

  macro_lbracket: macro_lbracket {
    compatible = "zmk,behavior-macro";
    #binding-cells = <0>;
    wait-ms = <50>;
    tap-ms = <50>;
    bindings = <&macro_release &kp LSHFT &kp RSHFT>, <&kp LBKT>;
    display-name = "Left Bracket";
  };

  macro_rbracket: macro_rbracket {
    compatible = "zmk,behavior-macro";
    #binding-cells = <0>;
    wait-ms = <50>;
    tap-ms = <50>;
    bindings = <&macro_release &kp LSHFT &kp RSHFT>, <&kp RBKT>;
    display-name = "Right Bracket";
  };

  macro_yank_line: macro_yank_line {
    compatible = "zmk,behavior-macro";
    #binding-cells = <0>;
    wait-ms = <20>;
    tap-ms = <20>;
    bindings = <&kp LG(LEFT)>, <&kp LS(LG(RIGHT))>, <&kp LG(C)>;
    display-name = "Yank Line";
  };

  macro_delete_line: macro_delete_line {
    compatible = "zmk,behavior-macro";
    #binding-cells = <0>;
    wait-ms = <20>;
    tap-ms = <20>;
    bindings = <&kp LG(LEFT)>, <&kp LS(LG(RIGHT))>, <&kp BSPC>;
    display-name = "Delete Line";
  };

  macro_cut_line: macro_cut_line {
    compatible = "zmk,behavior-macro";
    label = "macro_cut_line";
    #binding-cells = <0>;
    wait-ms = <20>;
    tap-ms = <20>;
    bindings = <&kp LG(LEFT)>, <&kp LS(LG(RIGHT))>, <&kp LG(X)>;
    display-name = "Cut Line";
  };

  macro_cut_line_end: macro_cut_line_end {
    compatible = "zmk,behavior-macro";
    label = "macro_cut_line_end";
    #binding-cells = <0>;
    wait-ms = <20>;
    tap-ms = <20>;
    bindings = <&kp LS(LG(RIGHT))>, <&kp LG(X)>;
    display-name = "Cut to End of Line";
  };

  macro_cut_word_left: macro_cut_word_left {
    compatible = "zmk,behavior-macro";
    label = "macro_cut_word_left";
    #binding-cells = <0>;
    wait-ms = <20>;
    tap-ms = <20>;
    bindings = <&kp LA(LS(LEFT))>, <&kp LG(X)>;
    display-name = "Cut Word Left";
  };

  macro_cut_word_right: macro_cut_word_right {
    compatible = "zmk,behavior-macro";
    label = "macro_cut_word_right";
    #binding-cells = <0>;
    wait-ms = <20>;
    tap-ms = <20>;
    bindings = <&kp LA(LS(RIGHT))>, <&kp LG(X)>;
    display-name = "Cut Word Right";
  };

  mac_sel_word: mac_sel_word {
    compatible = "zmk,behavior-macro";
    label = "mac_sel_word";
    #binding-cells = <0>;
    tap-ms = <40>;
    wait-ms = <150>; 
    bindings
        = <&kp LEFT>
        , <&kp LA(LEFT)>
        , <&kp LA(LS(RIGHT))>
        ;
    display-name = "Mac Select Word";
  };

  mac_dup_line: mac_dup_line {
    compatible = "zmk,behavior-macro";
    label = "mac_dup_line";
    #binding-cells = <0>;
    wait-ms = <20>;
    tap-ms = <20>;
    bindings = <&kp LG(LEFT)>, <&kp LS(LG(RIGHT))>, <&kp LG(C)>, <&kp RIGHT>, <&kp ENTER>, <&kp LG(V)>;
    display-name = "Smart Duplicate Line";
  };

  macro_vis_enter: macro_vis_enter {
    compatible = "zmk,behavior-macro";
    label = "macro_vis_enter";
    #binding-cells = <0>;
    wait-ms = <20>;
    tap-ms = <20>;
    bindings = <&mac_sel_word>, <&tog 11>;
    display-name = "Visual Mode Enter";
  };

  macro_vis_cut_word_left: macro_vis_cut_word_left {
    compatible = "zmk,behavior-macro";
    label = "macro_vis_cut_word_left";
    #binding-cells = <0>;
    wait-ms = <20>;
    tap-ms = <20>;
    bindings = <&kp LA(LS(LEFT))>, <&kp LG(X)>, <&tog 11>;
    display-name = "Visual Cut Word Left & Exit";
  };

  macro_vis_cut_word_right: macro_vis_cut_word_right {
    compatible = "zmk,behavior-macro";
    label = "macro_vis_cut_word_right";
    #binding-cells = <0>;
    wait-ms = <20>;
    tap-ms = <20>;
    bindings = <&kp LA(LS(RIGHT))>, <&kp LG(X)>, <&tog 11>;
    display-name = "Visual Cut Word Right & Exit";
  };

  macro_vis_cut_line: macro_vis_cut_line {
    compatible = "zmk,behavior-macro";
    label = "macro_vis_cut_line";
    #binding-cells = <0>;
    wait-ms = <20>;
    tap-ms = <20>;
    bindings = <&kp LG(LEFT)>, <&kp LS(LG(RIGHT))>, <&kp LG(X)>, <&tog 11>;
    display-name = "Visual Cut Line & Exit";
  };

  macro_vis_cut_line_end: macro_vis_cut_line_end {
    compatible = "zmk,behavior-macro";
    label = "macro_vis_cut_line_end";
    #binding-cells = <0>;
    wait-ms = <20>;
    tap-ms = <20>;
    bindings = <&kp LS(LG(RIGHT))>, <&kp LG(X)>, <&tog 11>;
    display-name = "Visual Cut Line End & Exit";
  };

  macro_vis_copy: macro_vis_copy {
    compatible = "zmk,behavior-macro";
    label = "macro_vis_copy";
    #binding-cells = <0>;
    wait-ms = <20>;
    tap-ms = <20>;
    bindings = <&kp LG(C)>, <&tog 11>;
    display-name = "Visual Copy & Exit";
  };

  macro_vis_cut: macro_vis_cut {
    compatible = "zmk,behavior-macro";
    label = "macro_vis_cut";
    #binding-cells = <0>;
    wait-ms = <20>;
    tap-ms = <20>;
    bindings = <&kp LG(X)>, <&tog 11>;
    display-name = "Visual Cut & Exit";
  };
};
